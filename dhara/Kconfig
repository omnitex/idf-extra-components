## dhara/Kconfig
```kconfig
menu "Dhara NAND FTL"

config DHARA_RADIX_DEPTH
    int "Radix tree depth (address bits)"
    default 32
    range 8 32
    help
      Number of bits used to address logical sectors in the Dhara radix
      tree map. Each metadata record stores this many 4-byte alt-pointers
      plus a 4-byte sector ID, so DHARA_META_SIZE = 4 + DHARA_RADIX_DEPTH * 4.

      Set this to ceil(log2(max_sectors)) for your device to reduce
      metadata overhead. For a device with N blocks of P pages each,
      max_sectors ≈ N*P/2, and the required depth is ceil(log2(max_sectors)).

      Use the DHARA_RADIX_DEPTH_FOR(num_blocks, log2_ppb) macro in map.h
      to compute the correct value.

      Default (32) is backward-compatible with all existing on-flash images
      that were written without a radix_depth header field.

      WARNING: Changing this value makes existing on-flash data unreadable.
      You must erase and reformat the NAND after changing this setting.

endmenu
```

## spi_nand_flash/ftl_eval/sdkconfig.defaults
```kconfig
CONFIG_IDF_TARGET="linux"
CONFIG_NAND_FLASH_FAULT_SIM=y
CONFIG_NAND_FLASH_ENABLE_BDL=y
```

## spi_nand_flash/host_test/sdkconfig.defaults.no-bdl
```kconfig
# Force legacy path so host_test links test_nand_flash.cpp + test_nand_flash_ftl.cpp
# CONFIG_NAND_FLASH_ENABLE_BDL is not set
```

## spi_nand_flash/perf_app/sdkconfig.defaults
```kconfig
# Disable watchdog — long-running perf benchmarks will trigger it otherwise
CONFIG_ESP_TASK_WDT_EN=n
# Larger stack for perf task (histogram arrays on stack)
CONFIG_ESP_MAIN_TASK_STACK_SIZE=8192
```

## spi_nand_flash_fatfs/examples/nand_flash_bdl/sdkconfig.defaults
```kconfig
# BDL stack for SPI NAND (Flash BDL -> WL BDL) requires IDF 6.0+ and this Kconfig option.
CONFIG_NAND_FLASH_ENABLE_BDL=y
CONFIG_ESP_TASK_WDT_EN=n
```
