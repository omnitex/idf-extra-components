## esp_nand_ubi/Kconfig
```kconfig
menu "NAND UBI configuration"

    config ESP_NAND_UBI_ENABLE
        bool "Enable UBI-like layer for SPI NAND flash"
        depends on NAND_FLASH_ENABLE_BDL
        default n
        help
            Enables the esp_nand_ubi component. Requires CONFIG_NAND_FLASH_ENABLE_BDL
            and ESP-IDF >= 6.0. Provides position-independent factory images and
            bad-block hiding on SPI NAND flash by exposing a flat logical-erase-block
            (LEB) address space per volume above the raw NAND block device.

    config ESP_NAND_UBI_RESERVED_PEBS
        int "Default number of reserved PEBs for bad-block pool"
        depends on ESP_NAND_UBI_ENABLE
        range 0 32
        default 4
        help
            Number of physical erase blocks held back as a spare pool for bad-block
            replacement. Used as the default when nand_ubi_config_t.reserved_pebs is
            not overridden by the caller.

    config ESP_NAND_UBI_ALLOC_SAMPLES
        int "Free PEBs sampled per allocation"
        depends on ESP_NAND_UBI_ENABLE
        range 1 8
        default 4
        help
            Each allocation reads the EC headers of this many randomly chosen free PEBs
            and takes the one with the lowest erase count. Erase counts are not kept in
            RAM. 1 picks a random free PEB with no wear leveling; 2 or more keep the
            erase-count spread bounded, and larger values narrow it further at the cost
            of one EC header read per extra sample.


    config ESP_NAND_UBI_CHECKPOINT
        bool "Attach checkpoint (fast attach)"
        depends on ESP_NAND_UBI_ENABLE
        default y
        help
            Keeps a snapshot of the LEB map and PEB states on flash, so attach reads the
            snapshot and a small set of PEBs instead of every PEB. Reserves a region at
            the start of the chip for the snapshot; erased LEBs keep their PEB until the
            next snapshot is written. A chip with checkpoints still attaches by full scan,
            also on Linux. See docs/fastmap-design.md.

            A volume created with this option off may reserve more LEBs than fit outside
            the region; attach then warns, and writes fail once the chip is full.

    config ESP_NAND_UBI_CKPT_REGION_PEBS
        int "Checkpoint region size in PEBs (0 = square root of the PEB count)"
        depends on ESP_NAND_UBI_CHECKPOINT
        range 0 1024
        default 0

    config ESP_NAND_UBI_CKPT_POOL_PEBS
        int "Free PEBs per checkpoint (0 = region size)"
        depends on ESP_NAND_UBI_CHECKPOINT
        range 0 1024
        default 0
        help
            Writes go to these PEBs between two checkpoints. A larger pool writes
            checkpoints less often, but attach reads more PEBs and the write that
            refills the pool takes longer.

endmenu
```

## esp_nand_ubi/examples/littlefs_on_ubi/main/Kconfig.projbuild
```kconfig
menu "LittleFS on UBI Example Configuration"

    config EXAMPLE_FORMAT_IF_MOUNT_FAILED
        bool "Format the flash if mount failed"
        default y
        help
            If this config item is set, format_if_mount_failed will be set to true and
            the LittleFS volume will be formatted if the first mount attempt fails (e.g.
            on a factory-blank chip with no prior LittleFS superblock).

    config EXAMPLE_WIPE_NAND_ON_BOOT
        bool "Erase the whole NAND chip on boot (destroys all data)"
        default n
        help
            Erases every good block of the raw NAND before attaching UBI, so the
            attach sees a blank chip and nand_ubi_get_blockdev() creates one volume
            spanning the whole chip. Use for one boot to measure the full-chip case,
            then disable it again: with it enabled, every boot starts from scratch.
endmenu
```

## esp_nand_ubi/examples/nand_ubi_powercut/main/Kconfig.projbuild
```kconfig
menu "NAND UBI power-cut test"

    choice PTEST_RESET
        prompt "How the workload is interrupted"
        default PTEST_RESET_AUTO
        help
            Auto: the app resets itself after a random delay, for unattended runs.
            The NAND stays powered, so a program or erase already started completes.
            Manual: the workload runs until power is removed (unplug the board).

        config PTEST_RESET_AUTO
            bool "Auto (esp_restart after a random delay)"
        config PTEST_RESET_MANUAL
            bool "Manual (unplug power)"
    endchoice

    config PTEST_RESET_MIN_MS
        int "Minimum delay before the auto reset (ms)"
        depends on PTEST_RESET_AUTO
        default 50

    config PTEST_RESET_MAX_MS
        int "Maximum delay before the auto reset (ms)"
        depends on PTEST_RESET_AUTO
        default 3000

    config PTEST_DATA_LEBS
        int "Data LEBs in the workload volume"
        range 4 400
        default 32
        help
            Every boot reads all pages of these LEBs to verify them, so verify time
            grows with this value.

    config PTEST_PAGES_PER_STEP
        int "Pages written per LEB rewrite"
        range 1 64
        default 16
        help
            Must not exceed the pages per LEB of the chip (62 on a 2 KiB-page,
            128 KiB-block NAND).

    config PTEST_STATS_LEBS
        int "LEBs in the stats volume (ring of one record per page)"
        range 2 16
        default 4

endmenu
```

## spi_nand_flash/Kconfig
```kconfig
menu "SPI NAND Flash configuration"

    config NAND_FLASH_VERIFY_WRITE
        bool "Verify SPI NAND flash writes"
        default n
        help
            If this option is enabled, any time SPI NAND flash is written then the data will be read
            back and verified. This can catch hardware problems with SPI NAND flash, or flash which
            was not erased before verification.

    config NAND_FLASH_ENABLE_BDL
        bool "Enable Block Device Layer (BDL) support"
        depends on IDF_INIT_VERSION >= "6.0"
        default n
        help
            Enable Block Device Layer (BDL) support for SPI NAND Flash. This provides:
            - Standard esp_blockdev_t interface for layered architecture
            - Flash Block Device Layer (raw NAND flash access)
            - Wear-Leveling Block Device Layer (logical sector access with wear leveling)
            - Advanced layered API (spi_nand_flash_init_with_layers)
            When disabled, only the legacy API is available.
            When enabled, the legacy spi_nand_flash_init_device() is not available (returns
            ESP_ERR_NOT_SUPPORTED). Use spi_nand_flash_init_with_layers().

            Note: This option requires ESP-IDF >= 6.0 (esp_blockdev component).
            Enabling this on ESP-IDF < 6.0 will result in a build error.

    config NAND_FLASH_PAGE_REGISTER_CACHE
        bool "Enable NAND page-register cache"
        default n
        help
            When enabled, the SPI NAND driver tracks whether the chip's
            internal page register already holds the requested page and
            skips the READ PAGE ADDRESS command (25-100 us) on repeated
            reads of the same page. The cache is invalidated on any
            program, erase, or mark-bad operation, since those overwrite
            the chip's internal register.
            Set to false to disable (no caching, original behaviour).

    config NAND_DHARA_FTL_MAP_PATH_CACHE
        bool "Enable Dhara FTL map path cache"
        default n
        help
            When enabled, Dhara FTL map caches the last successful read-only
            FTL map traversal. Consumes 136 bytes of memory. Consecutive
            sector lookups that share a common radix-tree prefix skip the
            already-known levels entirely, reducing Dhara FTL journal read meta
            calls by up to 31 of 32 for sequential sector access patterns.
            Set to false to disable (no RAM overhead, original behaviour).

    config NAND_DHARA_FTL_MAP_EXACT_REPEAT_CACHE
        bool "Enable Dhara FTL map exact-repeat fast path"
        depends on NAND_DHARA_FTL_MAP_PATH_CACHE
        default n
        help
            When enabled (on top of NAND_DHARA_FTL_MAP_PATH_CACHE), an exact
            repeat of the previous read-only sector lookup (same sector,
            journal unchanged since) skips the metadata read and radix-tree
            walk entirely and returns the cached result page directly.
            Consumes 4 extra bytes of memory on top of the path cache.
            Set to false to disable (path cache still walks one metadata
            read for a repeated lookup).

    config NAND_DHARA_JOURNAL_META_CACHE_SLOTS
        int "Dhara journal metadata checkpoint-page cache slots (0 = disabled)"
        range 0 8
        default 0
        help
            Number of full NAND pages cached in internal DRAM by the Dhara
            journal layer (below the FTL map caches above) to accelerate
            repeated dhara_journal_read_meta() reads from the same
            checkpoint group. On a cache miss, the whole checkpoint page is
            loaded and kept (not just the requested metadata slice), since
            on SPI NAND the READ PAGE ADDRESS command dominates read cost
            regardless of how many bytes are transferred -- so the full-page
            load amortises across every metadata slot within that
            checkpoint group. Cache entries are invalidated by key
            (physical checkpoint-page address) whenever that same page is
            rewritten or the journal is cleared, so a stale physical
            address can never be served after reuse.
            Each slot costs one NAND page (typically 2048 bytes) of
            DMA-aligned internal DRAM. Total cost: SLOTS x page_size bytes.
            Set to 0 to disable (no RAM overhead, original behaviour).

    config NAND_ENABLE_STATS
        bool "Host test statistics enabled"
        depends on IDF_TARGET_LINUX
        default n
        help
            This option enables gathering host test statistics and SPI NAND flash wear levelling simulation.

endmenu
```
